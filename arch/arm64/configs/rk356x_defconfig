## arch/arm64/configs/rk356x_defconfig
```kconfig
# Sample rk356x_defconfig for RK3566

CONFIG_ARCH_ROCKCHIP=y
CONFIG_ARCH_ARM64=y
CONFIG_ARCH_MULTI_V7=y
CONFIG_ARM64=y
CONFIG_ARM64_32=y
CONFIG_ARM64_64=y
CONFIG_ARM64_PA_BITS=40
CONFIG_ARM64_VA_BITS=48
CONFIG_ARMV8_DEPRECATED=y
CONFIG_ARMV8_CRYPTO=y

# CPU features
CONFIG_CPU_PABRT=y
CONFIG_CPU_PAN=y
CONFIG_CPU_V7=y
CONFIG_CPU_V8=y

# Memory configuration
CONFIG_ARM64_COHERENT_POOL=y
CONFIG_PHYS_ADDR_T_64BIT=y
CONFIG_ARM64_PA_BITS=40

# Rockchip specific configuration
CONFIG_ROCKCHIP_PHY=y
CONFIG_ROCKCHIP_VOP=y
CONFIG_ROCKCHIP_DRM=y
CONFIG_ROCKCHIP_HDMI=y
CONFIG_ROCKCHIP_RGA=y
CONFIG_ROCKCHIP_CE=y
CONFIG_ROCKCHIP_SDMA=y

# Kernel features
CONFIG_NETFILTER=y
CONFIG_NETFILTER_ADVANCED=y
CONFIG_INET=y
CONFIG_IP_NF_IPTABLES=y
CONFIG_IP_NF_TARGET_MASQUERADE=y
CONFIG_IPV6=y
CONFIG_INET6=y
CONFIG_NETDEVICES=y
CONFIG_PACKET=y
CONFIG_UNIX=y

# File system support
CONFIG_EXT4_FS=y
CONFIG_F2FS_FS=y
CONFIG_SQUASHFS=y
CONFIG_FUSE_FS=y
CONFIG_OVERLAY_FS=y

# Power management
CONFIG_PM=y
CONFIG_PM_SLEEP=y
CONFIG_ARM64_CPU_IDLE=y
CONFIG_ARM64_RAS=y

# Debugging
CONFIG_DEBUG_INFO=y
CONFIG_KGDB=y
CONFIG_KDB=y

# Networking
CONFIG_NET=y
CONFIG_NETFILTER=y
CONFIG_NETFILTER_XT_MATCH_IPVS=y

# Generic defconfig
CONFIG_CMDLINE="root=/dev/mmcblk0p2 rootwait rw"
```
